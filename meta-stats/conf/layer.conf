## meta-stats/conf/layer.conf
```bitbake
# We have a conf and classes directory, add to BBPATH
BBPATH .= ":${LAYERDIR}"

# We have recipes-* directories, add to BBFILES
BBFILES += "${LAYERDIR}/recipes-*/*/*.bb \
            ${LAYERDIR}/recipes-*/*/*.bbappend"

BBFILE_COLLECTIONS += "meta-stats"
BBFILE_PATTERN_meta-stats = "^${LAYERDIR}/"
BBFILE_PRIORITY_meta-stats = "6"

LAYERDEPENDS_meta-stats = "core"
LAYERSERIES_COMPAT_meta-stats = "warrior zeus"
```
